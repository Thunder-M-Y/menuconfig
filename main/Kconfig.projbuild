## main/Kconfig.projbuild
```kconfig
menu "LED Configure"
    config LED_GPIO_NUM
        int "LED GPIO Number"
        default 5
        range 0 48
        help
            Please select the GPIO number used by the LED
    config LED_BLINK_TIME
        int "Blinking delay time (ms)"
        default 1000
        range 100 10000
        help
            Blinking delay time(ms)
    choice LED_INIT_STAT
        prompt "Please set the initial state of LED"
        default LED_STAT_ON
        help
            Default state of LED
            ON  - Turn on the LED when the system stats
            OFF - Turn off the LED when the system stats
        config LED_STAT_ON
            bool "ON"
        config LED_STAT_OFF
            bool "OFF"
    endchoice
endmenu
menu "KEY Configure"
    config KEY_GPIO_NUM
        int "KEY GPIO Number"
        default 4
        range 0 48
        help
            Please select the GPIO number used by the KEY
endmenu
```
